## Kconfig
```kconfig
menuconfig PAW3222
    bool "PAW3222 mouse optical sensor"
  select SPI
    help
      Enable PAW3222 mouse optical sensor.

if PAW3222

config PAW3222_POINTER_ACCELERATION
    bool "PAW3222 same-frame pointer acceleration support"
    default n
    help
      Allow an opted-in PAW3222 node to apply a vector-based gain curve to
      each complete X/Y report frame. Nodes without the Devicetree opt-in keep
      the original linear path.

endif
```

## dts/bindings/pixart,paw3222.yaml
```yaml
# Copyright 2024 Google LLC
# Copyright 2025 sekigon-gonnoc
# SPDX-License-Identifier: Apache-2.0

description: PAW32xx ultra low power wireless mouse chip

compatible: "pixart,paw3222"

include: spi-device.yaml

properties:
  irq-gpios:
    type: phandle-array
    required: true
    description:
      GPIO connected to the motion pin, active low.

  power-gpios:
    type: phandle-array
    required: false
    description:
      GPIO connected to the power control pin.

  res-cpi:
    type: int
    description: |
      CPI resolution for the sensor. This can also be changed in runtime using
      the paw32xx_set_resolution() API.

  force-awake:
    type: boolean
    description: |
      Initialize the sensor in "force awake" mode. This can also be enabled or
      disabled in runtime by the application using the paw32xx_force_awake()
      API.

  report-interval-ms:
    type: int
    default: 0
    description: |
      Aggregate deltas and report them at most once per interval. Zero reports
      every sample immediately. A small non-zero interval is useful on split
      peripherals whose transport has bounded notification buffers.

  pointer-acceleration:
    type: boolean
    description: |
      Apply the configured vector-based gain curve to each complete X/Y report
      frame. This requires a non-zero report-interval-ms and is intended for a
      central device that can evaluate the bypass layers.

  pointer-acceleration-base-gain-milli:
    type: int
    default: 1000
    description: Low-speed gain in thousandths.

  pointer-acceleration-takeoff-speed:
    type: int
    default: 16
    description: Vector speed at or below which the base gain is used.

  pointer-acceleration-full-speed:
    type: int
    default: 80
    description: Vector speed at which the gain transition reaches its full slope.

  pointer-acceleration-max-gain-milli:
    type: int
    default: 3000
    description: Maximum high-speed gain in thousandths.

  pointer-acceleration-reference-interval-ms:
    type: int
    default: 8
    description: Report interval used to normalize genuinely delayed frames.

  pointer-acceleration-idle-reset-ms:
    type: int
    default: 60
    description: Idle duration that clears fractional carry state.

  pointer-acceleration-scroll-layer:
    type: int
    default: 2
    description: Layer on which acceleration is bypassed for raw scrolling.

  pointer-acceleration-gesture-layer:
    type: int
    default: 3
    description: Layer on which acceleration is bypassed for raw gestures.

  pointer-acceleration-gesture-layer-2:
    type: int
    description: |
      Optional second layer on which acceleration is bypassed for raw gestures.
      When omitted, it defaults to pointer-acceleration-gesture-layer.
```
